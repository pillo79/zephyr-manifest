## west.yml
```yaml
# Copyright (c) 2021 Nordic Semiconductor ASA
# SPDX-License-Identifier: Apache-2.0

manifest:
  self:
    path: manifest

  remotes:
    - name: zephyrproject-rtos
      url-base: https://github.com/zephyrproject-rtos
    - name: facchinm
      url-base: git@github.com:facchinm
    - name: pillo79
      url-base: git@github.com:pillo79

  projects:
    - name: zephyr
      remote: pillo79
      revision: pr-stable-dt-hash
      import:
        name-allowlist:
          - cmsis
          - littlefs
          - hal_nxp
          - hal_stm32
          - hal_renesas
          - segger
    - name: ArduinoCore-Zephyr
      path: core
      revision: next
      url: git@github.com:pillo79/zephyr-gsoc-core
    - name: ArduinoCore-API
      path: modules/ArduinoCore-API
      url: git@github.com:pillo79/ArduinoCore-API
      revision: zephyr
```
